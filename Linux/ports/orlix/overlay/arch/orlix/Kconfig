## Linux/ports/orlix/overlay/arch/orlix/Kconfig
```kconfig
config ORLIX
	bool "Orlix architecture"
	default y
	select HAVE_ARCH_SECCOMP_FILTER

config MMU
	bool
	default y
```

## OrlixKernel/Sources/ports/orlix/overlay/drivers/orlix/Kconfig
```kconfig
menu "Orlix drivers"

depends on ORLIX

source "drivers/orlix/block/Kconfig"
source "drivers/orlix/virtio/Kconfig"
source "drivers/orlix/tty/Kconfig"

endmenu
```
