## OrlixKernel/Sources/ports/orlix/overlay/arch/orlix/Kconfig
```kconfig
config ORLIX
	bool "Orlix architecture"
	default y
	select GENERIC_IRQ_SHOW
	select IRQ_DOMAIN
	select HAVE_PAGE_SIZE_4KB
	select HAVE_PAGE_SIZE_16KB
	select HAVE_EXIT_THREAD
	select OF
	select OF_IRQ
	select HAS_IOMEM
	select GENERIC_VDSO_TIME_NS
	select HAS_DMA
	select ARCH_WANT_FRAME_POINTERS
	select GENERIC_CPU_DEVICES
	select LOCK_MM_AND_FIND_VMA
	select CLONE_BACKWARDS
	select THREAD_INFO_IN_TASK

config 64BIT
	bool
	default y

config MMU
	bool
	default y

config PGTABLE_LEVELS
	int
	default 4

config GENERIC_CSUM
	def_bool y

config GENERIC_CALIBRATE_DELAY
	def_bool y

config GENERIC_HWEIGHT
	def_bool y

config ORLIX_HOSTED_ASYNC_USER_TIMER
	bool
	default y

config ORLIX_HOSTED_EXEC_NATIVE
	bool "Use native hosted user execution"
	default n
	help
	  Keep the existing HostAdapter trap-frame native execution backend
	  available only as an explicit non-product diagnostic, oracle, test,
	  or benchmark backend. This backend cannot provide product-development,
	  simulator-readiness, or release evidence.

config ORLIX_TCTI_HOSTED_EXEC
	bool "Use OrlixTCTI hosted user execution"
	default y
	help
	  Enable the Orlix-owned no-JIT same-ISA threaded interpreter backend
	  for AArch64 Linux ELF userspace. This backend executes guest text as
	  host data and must not request host-executable mappings for guest ELF
	  text.

config ORLIX_TCTI_FEAT_THE
	bool "Enable FEAT_THE execution in OrlixTCTI"
	depends on ORLIX_TCTI_HOSTED_EXEC
	default y
	help
	  Select the production architectural domain for Translation Hardening
	  Extension RCW and RCWS instructions. Runtime EL0 entry remains gated by
	  the Linux HWCAP projection.

config ORLIX_TCTI_FEAT_D128
	bool "Use the FEAT_D128 RCW domain"
	depends on ORLIX_TCTI_FEAT_THE
	default n
	help
	  Select the 128-bit RCW/RCWS domain. When disabled, the scalar 64-bit
	  domain is selected and pair RCW encodings are architecturally undefined.

config ORLIX_TCTI_RCWMASK_EL1_LO
	hex
	depends on ORLIX_TCTI_FEAT_THE
	default 0x0

config ORLIX_TCTI_RCWMASK_EL1_HI
	hex
	depends on ORLIX_TCTI_FEAT_D128
	default 0x0

config ORLIX_TCTI_RCWSMASK_EL1_LO
	hex
	depends on ORLIX_TCTI_FEAT_THE
	default 0x0

config ORLIX_TCTI_RCWSMASK_EL1_HI
	hex
	depends on ORLIX_TCTI_FEAT_D128
	default 0x0

config ORLIX_TCTI_TCR2_EL1_ENABLED
	bool
	depends on ORLIX_TCTI_FEAT_THE && !ORLIX_TCTI_FEAT_D128
	default n

config ORLIX_TCTI_TCR2_EL1_PNCH
	bool
	depends on ORLIX_TCTI_TCR2_EL1_ENABLED
	default n

config ORLIX_TCTI_DEBUG_SWITCH
	bool "Enable OrlixTCTI switch debug oracle"
	depends on ORLIX_TCTI_HOSTED_EXEC
	default n
	help
	  Build the slow switch-dispatch correctness oracle used to test OrlixTCTI
	  decoding, fault, syscall, and register semantics. Keep this test-only
	  implementation disabled in product profiles.

config ORLIX_TCTI_SYSCALL_TRACE
	bool "Trace every OrlixTCTI syscall entry and return"
	depends on ORLIX_TCTI_HOSTED_EXEC
	default n
	help
	  Enable full per-syscall OrlixTCTI tracing. Normal OrlixTCTI execution keeps
	  syscall-entry reporting bounded so app-hosted Linux workloads are not
	  throttled by console mirroring.

config ORLIX_TCTI_KUNIT_TEST
	bool "Enable OrlixTCTI KUnit tests"
	depends on ORLIX_TCTI_HOSTED_EXEC && KUNIT
	default n

source "kernel/Kconfig.hz"
```
